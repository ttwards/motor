## sample.yaml
```
sample:
  name: IMU四元数EKF姿态估计示例
  description: 使用ARES框架的四元数扩展卡尔曼滤波器处理IMU传感器数据并估计姿态角度
tests:
  sample.ares.imu.quaternion_ekf:
    tags: sensor imu ekf ares
    depends_on: spi sensor
    filter: dt_nodelabel_enabled("bmi08x_accel") and dt_nodelabel_enabled("bmi08x_gyro")
    integration_platforms:
      - robomaster_board_c
      - dm_mc02
    harness: console
    harness_config:
      type: multi_line
      regex:
        - "q: [0-9.-]+, [0-9.-]+, [0-9.-]+, [0-9.-]+"
        - "Yaw: [0-9.-]+, Pitch: [0-9.-]+, Roll: [0-9.-]+"
```

## prj.conf
```kconfig
CONFIG_ARES=y
CONFIG_EKF_LIB=y

CONFIG_CMSIS_DSP=y
CONFIG_CMSIS_DSP_MATRIX=y
CONFIG_CMSIS_DSP_CONTROLLER=y
CONFIG_CMSIS_DSP_FASTMATH=y

CONFIG_PLOTTER=y
CONFIG_ARESPLOT_FREQ=500

CONFIG_CHASSIS=n
```

## src/main.c
```c
/*
 * Copyright (c) 2024 ttwards <12411711@mail.sustech.edu.cn>
 *
 * SPDX-License-Identifier: Apache-2.0
 */

#include <math.h>
#include <stddef.h>
#include <stdint.h>
#include <zephyr/device.h>
#include <zephyr/logging/log.h>
#include <zephyr/kernel.h>
#include <zephyr/drivers/motor.h>
#include <zephyr/drivers/sbus.h>
#include <ares/board/init.h>
#include <ares/ekf/imu_task.h>
#include <ares/vofa/justfloat.h>
#include <ares/usb_bulk_trans/usb_trans.h>
#include "ares/ekf/QuaternionEKF.h"
#include "devices.h"
#include <zephyr/debug/thread_analyzer.h>
#include <ares/ekf/algorithm.h>

LOG_MODULE_REGISTER(main, LOG_LEVEL_DBG);

#ifndef PI
#define PI 3.14159265f
#endif

/* CAN Feedback to console*/
void console_feedback(void *arg1, void *arg2, void *arg3)
{
	while (1) {
		LOG_INF("q: %f, %f, %f, %f", QEKF_INS.q[0], QEKF_INS.q[1], QEKF_INS.q[2],
			QEKF_INS.q[3]);
		LOG_INF("Yaw: %f, Pitch: %f, Roll: %f", QEKF_INS.Yaw, QEKF_INS.Pitch,
			QEKF_INS.Roll);
		k_msleep(200);
	}
}
K_THREAD_DEFINE(feedback_thread, 4096, console_feedback, NULL, NULL, NULL, -1, 0, 100);

float vel[3] = {0};
float pos[3] = {0};
float turned_accel[3] = {0};
void Sensor_update_cb(QEKF_INS_t *QEKF)
{
}

float vel_data[4] = {0};
void trans_cb(int arg)
{
	return;
}

int main(void)
{
	k_msleep(2000);

	IMU_Sensor_trig_init(accel_dev, gyro_dev);
	IMU_Sensor_set_update_cb(Sensor_update_cb);

	while (1) {
		k_msleep(10);
	}
}
```

## src/devices.h
```c
#include <zephyr/device.h>

/* Devicetree */
#define ACCEL_NODE DT_NODELABEL(bmi08x_accel)
const struct device *accel_dev = DEVICE_DT_GET(ACCEL_NODE);

#define GYRO_NODE DT_NODELABEL(bmi08x_gyro)
const struct device *gyro_dev = DEVICE_DT_GET(GYRO_NODE);

#define MAG_NODE DT_NODELABEL(ist8310)
const struct device *mag_dev = DEVICE_DT_GET(MAG_NODE);
```
