## Kconfig
```kconfig
# Copyright (c) 2021 Nordic Semiconductor ASA
# SPDX-License-Identifier: Apache-2.0
#
# This Kconfig file is picked by the Zephyr build system because it is defined
# as the module Kconfig entry point (see zephyr/module.yml). You can browse
# module options by going to Zephyr -> Modules in Kconfig.

# rsource "drivers/Kconfig"
# rsource "lib/Kconfig"

config MOTOR_DJI
    bool "Enable MOTOR_DJI"
    default n

config ARES_SBUS
	bool "Enable SBUS"
	default n

config ARES_SBUS_INIT_PRIORITY
	int "SBUS init priority"
	default 90
	help
		fuck

config MOTOR_LOG_LEVEL
    int "Motor log level"
    default 4
    help
    	The log level of motor driver

config MOTOR_INIT_PRIORITY
    int "Motor init priority"
    default 90
    help
    	The init priority of motor driver
```

## boards/damiao/dm_mc02/Kconfig.dm_mc02
```kconfig
# Copyright (c) 2024, ttwards <xuwenxi0517@gmail.com>
# SPDX-License-Identifier: Apache-2.0

config BOARD_DM_MC02
	select SOC_STM32H723VG
```

## boards/damiao/dm_mc02/dm_mc02_defconfig
```kconfig
# Copyright (c) 2024, ttwards <xuwenxi0517@gmail.com>
# SPDX-License-Identifier: Apache-2.0

# Enable MPU
CONFIG_ARM_MPU=n

# LOG CONFIG
CONFIG_LOG=y
CONFIG_UART_CONSOLE=y
CONFIG_CONSOLE=y
CONFIG_STDOUT_CONSOLE=y
CONFIG_CBPRINTF_FP_SUPPORT=y

# Enable HW stack protection
CONFIG_HW_STACK_PROTECTION=n

# enable GPIO
CONFIG_GPIO=y

#CAN
CONFIG_CAN=y
CONFIG_CAN_DEFAULT_BITRATE=1000000

# Enable UART console
CONFIG_SERIAL=y
CONFIG_UART_ASYNC_API=y
CONFIG_UART_INTERRUPT_DRIVEN=y
CONFIG_UART_LINE_CTRL=y

CONFIG_SPI=y

CONFIG_DMA=y

CONFIG_USB_DEVICE_STACK=y
CONFIG_USB_DEVICE_PRODUCT="Zephyr CDC ACM sample"
CONFIG_USB_DEVICE_PID=0x0001
CONFIG_USB_CDC_ACM=y

CONFIG_USB_DEVICE_INITIALIZE_AT_BOOT=y

# CONFIG_MEM_ATTR=y
# CONFIG_MEM_ATTR_HEAP=y

CONFIG_DCACHE=n

# Enable FPU
CONFIG_FPU=y
CONFIG_FPU_SHARING=y

CONFIG_LED=y
CONFIG_LED_STRIP=y
CONFIG_LED_STRIP_LOG_LEVEL_DBG=y

CONFIG_WS2812_STRIP_SPI=y
# CONFIG_SPI_STM32_INTERRUPT=y

CONFIG_SCHED_THREAD_USAGE=y

CONFIG_SENSOR=y
CONFIG_BMI08X=y
# CONFIG_BMI08X_ACCEL_TRIGGER_NONE is not set
# CONFIG_BMI08X_ACCEL_TRIGGER_GLOBAL_THREAD is not set
CONFIG_BMI08X_ACCEL_TRIGGER_OWN_THREAD=y
CONFIG_BMI08X_ACCEL_THREAD_PRIORITY=10
CONFIG_BMI08X_ACCEL_TRIGGER_NONE=n
CONFIG_BMI08X_ACCEL_THREAD_STACK_SIZE=2048
# CONFIG_BMI08X_GYRO_TRIGGER_NONE is not set
# CONFIG_BMI08X_GYRO_TRIGGER_GLOBAL_THREAD is not set
CONFIG_BMI08X_GYRO_TRIGGER_OWN_THREAD=y
CONFIG_BMI08X_GYRO_TRIGGER_NONE=n
CONFIG_BMI08X_GYRO_THREAD_PRIORITY=10
CONFIG_BMI08X_GYRO_THREAD_STACK_SIZE=2048
CONFIG_BMI08X_I2C_WRITE_BURST_SIZE=16

CONFIG_CRC=y
```

## boards/dji/robomaster_board_c/robomaster_board_c_defconfig
```kconfig
# Copyright (c) 2024, ttwards <xuwenxi0517@gmail.com>
# SPDX-License-Identifier: Apache-2.0

# Enable MPU
CONFIG_ARM_MPU=n

# Float i/o
CONFIG_CBPRINTF_FP_SUPPORT=y

# Enable HW stack protection
CONFIG_HW_STACK_PROTECTION=n

# enable GPIO
CONFIG_GPIO=y

# Enable UART console
CONFIG_SERIAL=y
CONFIG_UART_ASYNC_API=y
CONFIG_UART_INTERRUPT_DRIVEN=y

# 启用 UART 控制台
CONFIG_CONSOLE=y
CONFIG_UART_CONSOLE=y

# 禁用 SEGGER RTT
CONFIG_USE_SEGGER_RTT=n

# 启用事件支持
CONFIG_EVENTS=y

CONFIG_LOG=y
CONFIG_LOG_BLOCK_IN_THREAD=y
CONFIG_LOG_MODE_DEFERRED=n
CONFIG_LOG_BACKEND_UART_ASYNC=y

CONFIG_SPI=y
CONFIG_SPI_STM32_DMA=y

CONFIG_DMA=y

CONFIG_FPU=y

CONFIG_PWM=y

CONFIG_CAN=y

CONFIG_SENSOR=y
CONFIG_BMI08X=y
CONFIG_BMI08X_ACCEL_TRIGGER_OWN_THREAD=y
CONFIG_BMI08X_ACCEL_THREAD_PRIORITY=10
CONFIG_BMI08X_ACCEL_THREAD_STACK_SIZE=2048
CONFIG_BMI08X_GYRO_TRIGGER_OWN_THREAD=y
CONFIG_BMI08X_GYRO_THREAD_PRIORITY=10
CONFIG_BMI08X_GYRO_THREAD_STACK_SIZE=2048
CONFIG_BMI08X_I2C_WRITE_BURST_SIZE=16

CONFIG_IMU_PWM_TEMP_CTRL=y

CONFIG_FLASH=y
CONFIG_FLASH_MAP=y
CONFIG_ZMS=y
CONFIG_ZMS_LOG_LEVEL_ERR=y

CONFIG_DMA_STM32=y # STM32 UART 驱动

CONFIG_USB_DEVICE_STACK=y
CONFIG_USB_DEVICE_MANUFACTURER="ARES"
CONFIG_USB_DEVICE_PRODUCT="ARES USB Transfer Device"
CONFIG_USB_DEVICE_SN="520131499992025A"
CONFIG_USB_DEVICE_VID=0x1209
CONFIG_USB_DEVICE_PID=0x0001

CONFIG_USB_DEVICE_INITIALIZE_AT_BOOT=n

CONFIG_CMSIS_DSP=y
CONFIG_CMSIS_DSP_MATRIX=y
CONFIG_CMSIS_DSP_CONTROLLER=y
CONFIG_CMSIS_DSP_FASTMATH=y

CONFIG_PID=y

CONFIG_ISR_STACK_SIZE=3200
CONFIG_MAIN_STACK_SIZE=3200
CONFIG_SYSTEM_WORKQUEUE_STACK_SIZE=3200

CONFIG_PLOTTER=y
CONFIG_PLOTTER_FREQ=300

CONFIG_THREAD_ANALYZER=y
```

## drivers/chassis/Kconfig
```kconfig
menuconfig CHASSIS
  bool "Swerve Chassis Driver Support"
  depends on Motor
  help
    Enable support for the swerve chassis driver, including
    features such as steering and wheel configuration.

if CHASSIS
  config CHASSIS_STEER
    bool "Steer Chassis"
    depends on CHASSIS
    help
      Enable support for swerve steering in the chassis driver.
endif # CHASSIS
```

## drivers/motor/Kconfig
```kconfig
# Motor driver configuration options

# Copyright (c) 2024 ttwards <12411711@mail.sustech.edu.cn>
# SPDX-License-Identifier: Apache-2.0

menuconfig MOTOR
    bool "Motor drivers"
    help
      Enable support for motors.

if MOTOR

module = MOTOR
module-str = MOTOR
source "subsys/logging/Kconfig.template.log_config"

config MOTOR_DJI
    bool "MOTOR DJI"
    help
      Add support for dji motors
    select PID

config MOTOR_DM
	bool "MOTOR DM"
	help
	  Add support for dm motors
    select PID

config MOTOR_MI
  bool "MOTOR MI"
  help
    Add support for mi motors
  select PID
    
config MOTOR_LOG_LEVEL
    int "Motor log level"
    default 4
    help
      The log level of motor driver

config MOTOR_INIT_PRIORITY
    int "Motor init priority"
    default 90
    help
      The init priority of motor driver
endif
```

## dts/bindings/canbus/vnd,canbus.yaml
```yaml
description: Motor CAN bus

compatible: "vnd,canbus"

include: [base.yaml]

properties:
  can_device:
    type: phandle
    required: true  
```

## dts/bindings/chassis/ares,chassis.yaml
```yaml
# Copyright (c) 2025 ttwards <12411711@mail.sustech.edu.cn>

# SPDX-License-Identifier: Apache-2.0

description: Multi Wheel Chassis

compatible: "ares,chassis"

include: [base.yaml]

properties:
  wheels:
    type: phandle-array
    required: true
    specifier-space: wheel
  speed-limit:
    type: string
  angle-pid:
    type: phandle
    required: true
  track_angle:
    type: boolean
```

## dts/bindings/chassis/ares,swchassis.yaml
```yaml
# Copyright (c) 2025 ttwards <12411711@mail.sustech.edu.cn>

# SPDX-License-Identifier: Apache-2.0

description: Steer Wheel Chassis

compatible: "ares,swchassis"

include: [base.yaml]

properties:
  steerwheels:
    type: phandle-array
    required: true
    specifier-space: steerwheel
  speed-limit:
    type: string
  angle-pid:
    type: phandle
    required: true
```

## dts/bindings/chassis/steer,chassis.yaml
```yaml
description: Steer chassis binding

compatible: "steer,chassis"

include: [base.yaml]

properties:
  wheel-count:
    type: int
    required: true
    description: Number of wheels in the chassis

child-binding:
  description: Configuration for each swerve wheel
  properties:
    drive-motor:
      type: phandle
      required: true
      description: Reference to the drive motor node
    steering-motor:
      type: phandle
      required: true
      description: Reference to the steering motor node
    wheel-distance:
      type: int
      required: true
      description: Wheel-to-chassis center distance (millimeters)
    wheel-angle:
      type: int
      required: true
      description: Angle between the wheel-to-chassis center line and the x-axis (0.1 degrees)
    wheel-radius:
      type: int
      required: true
      description: Wheel radius (millimeters)
```

## dts/bindings/esc/dji,c620esc.yaml
```yaml
description: DJI C620 Electronic Speed Controller

compatible: "dji,c620esc"

include: [base.yaml]

properties:
  reg:
    required: true

  interrupts:
    required: true

  clocks:
    required: true

  can-controller:
    required: true

  tx_id:
    required: true
  
  rx_id:
    required: true
```

## dts/bindings/imu/ares,ekf.yaml
```yaml
# Copyright (c) 2024 ttwards <12411711@mail.sustech.edu.cn>

# SPDX-License-Identifier: Apache-2.0

description: EKF for IMU

compatible: "ares,ekf"

properties:
  IMU_QuaternionEKF_F:
    description: IMU_QuaternionEKF_F
    type: array
    default: [1, 0, 0, 0, 0, 0,
              0, 1, 0, 0, 0, 0,
              0, 0, 1, 0, 0, 0,
              0, 0, 0, 1, 0, 0,
              0, 0, 0, 0, 1, 0,
              0, 0, 0, 0, 0, 1]
  IMU_QuaternionEKF_P:
    description: IMU_QuaternionEKF_P
    type: array
    default: [100000, 0.1, 0.1, 0.1, 0.1, 0.1,
              0.1, 100000, 0.1, 0.1, 0.1, 0.1,
              0.1, 0.1, 100000, 0.1, 0.1, 0.1,
              0.1, 0.1, 0.1, 100000, 0.1, 0.1,
              0.1, 0.1, 0.1, 0.1, 100, 0.1,
              0.1, 0.1, 0.1, 0.1, 0.1, 100]
  gyro_phy:
    description: Gryo Device
    type: phandle
  accel_phy:
    description: Accel Device
    type: phandle
    
  gyro_x_phy:
    description: Gryo X Device
    type: phandle
  gyro_y_phy:
    description: Gryo Y Device
    type: phandle
  gyro_z_phy:
    description: Gryo Z Device
    type: phandle
  accel_x_phy:
    description: Accel X Device
    type: phandle
  accel_y_phy:
    description: Accel Y Device
    type: phandle
  accel_z_phy:
    description: Accel Z Device
    type: phandle
```

## dts/bindings/motor/dji,m3508.yaml
```yaml
# Copyright (c) 2024 ttwards <12411711@mail.sustech.edu.cn>

# SPDX-License-Identifier: Apache-2.0

description: DJI M3508 Motor

compatible: "dji,m3508"

include: [base.yaml]

properties:
  tx_addr:
    type: int
    required: true
  rx_addr:
    type: int
    required: true
  can_channel:
    type: phandle
    required: true  
  gear_ratio:
    type: int
    required: true
  label:
    type: string
  capabilities:
    type: uint8-array
    required: true
  controllers:
    type: phandles
    required: true
```

## dts/bindings/motor/dji,motor.yaml
```yaml
# Copyright (c) 2024 ttwards <12411711@mail.sustech.edu.cn>

# SPDX-License-Identifier: Apache-2.0

description: DJI Motor

compatible: "dji,motor"

include: [base.yaml]

properties:
  id:
    type: int
    required: true
  tx_id:
    type: int
    required: true
  rx_id:
    type: int
    required: true
  can_channel:
    type: phandle
    required: true  
  gear_ratio:
    type: int
    required: true
  controllers:
    type: phandles
    required: true
  capabilities:
    type: string-array
    required: true
  is_m3508:
    type: boolean
    required: false
  is_m2006:
    type: boolean
    required: false
  is_gm6020:
    type: boolean
    required: false
```

## dts/bindings/motor/dm,motor.yaml
```yaml
# Copyright (c) 2024 ttwards <12411711@mail.sustech.edu.cn>

# SPDX-License-Identifier: Apache-2.0

description: Da Miao Motor

compatible: "dm,motor"

include: [base.yaml]

properties:
  id:
    type: int
    required: true
  tx_id:
    type: int
    required: true
  rx_id:
    type: int
    required: true
  can_channel:
    type: phandle
    required: true  
  gear_ratio:
    type: int
    required: true
  controllers:
    type: phandles
    required: true
  capabilities:
    type: string-array
    required: true
```

## dts/bindings/pid/pid,single.yaml
```yaml
# Copyright (c) 2024 ttwards <12411711@mail.sustech.edu.cn>

# SPDX-License-Identifier: Apache-2.0

description: Single PID Controller

compatible: "pid,single"

include: [base.yaml]

properties:
  k_p:
    type: int
    required: true
  k_i:
    type: int
    required: true
  k_d: 
    type: int
    required: true
```

## dts/bindings/pid/pid.mit.yaml
```yaml
# Copyright (c) 2024 ttwards <12411711@mail.sustech.edu.cn>

# SPDX-License-Identifier: Apache-2.0

description: PID MIT Controller

compatible: "pid,mit"

include: [base.yaml]

properties:
  k_p:
    type: int
    required: true
  k_i:
    type: int
    required: true
  k_d: 
    type: int
    required: true
```

## include/ares/Kconfig
```kconfig
# ARES configuration options

# Copyright (c) 2025 ttwards <12411711@mail.sustech.edu.cn>
# SPDX-License-Identifier: Apache-2.0

rsource "connectivity/Kconfig"

menuconfig ARES
    bool "ARES options"
    help
      Enable support for ares modules.

module = ARES
module-str = ARES

config IMU_PWM_TEMP_CTRL
	select PID
    bool "IMU_PWM_TEMP_CTRL"
    help
      Enable IMU PWM TEMP CTRL
	
config AUTO_PROBE_GYRO_BIAS
	bool "AUTO_PROBE_GYRO_BIAS"
	help
	  Enable AUTO PROBE GYRO BIAS

config EKF_LIB
	bool "EKF_LIB"
	select CMSIS_DSP
	select CONFIG_CMSIS_DSP_MATRIX
	help
	  Enable EKF_LIB

config VOFA_LIB
	bool "VOFA_LIB"
	help
	  Enable VOFA_LIB

config MASTER_BOARD
	bool "MASTER_BOARD"
	help
	  Enable MASTER_BOARD

config SLAVE_BOARD
	bool "SLAVE_BOARD"
	help
	  Enable SLAVE_BOARD

config UART_TRANS_LIB
	bool "UART_TRANS_LIB"
	help
	  Enable UART_TRANS_LIB

config EXPERIMENTAL_BULK_LIB
	bool "EXPERIMENTAL_BULK_LIB"
	help
	  Enable EXPERIMENTAL_BULK_LIB
```
